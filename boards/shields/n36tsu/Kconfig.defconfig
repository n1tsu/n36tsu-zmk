## boards/shields/n36tsu/Kconfig.defconfig
```kconfig
if SHIELD_N36TSU_LEFT

# Name must be less than 16 characters long!
config ZMK_KEYBOARD_NAME
    default "n36tsu"

config ZMK_SPLIT_ROLE_CENTRAL
    default y

endif

if SHIELD_N36TSU_LEFT || SHIELD_N36TSU_RIGHT

config ZMK_SPLIT
    default y

config ZMK_DISPLAY_STATUS_SCREEN_CUSTOM_ROTATE
    bool "Rotates screens -90 for main and 90 for side"

endif
```

## boards/shields/n36tsu/Kconfig.shield
```kconfig
config SHIELD_N36TSU_LEFT
    def_bool $(shields_list_contains,n36tsu_left)

config SHIELD_N36TSU_RIGHT
    def_bool $(shields_list_contains,n36tsu_right)
```

## config/west.yml
```yaml
manifest:
  remotes:
    - name: zmkfirmware
      url-base: https://github.com/zmkfirmware
    # Additional modules containing boards/shields/custom code can be listed here as well
    # See https://docs.zephyrproject.org/3.2.0/develop/west/manifest.html#projects
    - name: zmkn1tsu
      url-base: https://github.com/n1tsu
  projects:
    - name: zmk
      remote: zmkn1tsu
      revision: rotate-display
      import: app/west.yml
  self:
    path: config
```
